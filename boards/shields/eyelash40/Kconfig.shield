## boards/shields/eyelash40/Kconfig.shield
```kconfig
# Copyright (c) 2020 The ZMK Contributors
# SPDX-License-Identifier: MIT

config SHIELD_EYELASH40
    def_bool $(shields_list_contains,eyelash40)
```
